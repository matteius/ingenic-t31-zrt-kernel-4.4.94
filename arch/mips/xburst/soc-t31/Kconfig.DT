## arch/mips/xburst/soc-t31/Kconfig.DT
```kconfig
config DT_T31_SWAN
	bool "t31 swan"

config DT_T31_PERSONALCAM
	bool "Experimental t31 based personal camera"

config DT_T31X_WYZE_V3
	bool "t31x based Wyze V3 clone"

CONFIG DT_T31L_CINNADO_D1
    bool "t31l based Cinnado D1 clone"
```

## drivers/clk/ingenic/Kconfig
```kconfig
config COMMON_CLK_INGENIC
    bool "Enable support for Ingenic common clocks"
    depends on (MACH_XBURST || MACH_XBURST2) && COMMON_CLK
    select MFD_SYSCON
    select INGENIC_CLK_DEBUG_FS
    help
      Support for the common clock framework for Ingenic processors.

config INGENIC_CLK_DEBUG_FS
    bool "Enable Ingenic common clock debugfs"
    depends on DEBUG_FS
    help
      Enable debugfs for the Ingenic common clocks.

config CLK_X2000_V12
    bool "Clock for Ingenic X2000 v12 SoC"
    depends on SOC_X2000_V12
    select COMMON_CLK_INGENIC
    help
      Build the clock driver for the Ingenic X2000-v12 SoC.

config CLK_T40
    bool "Clock for Ingenic T40 SoC"
    depends on SOC_T40
    select COMMON_CLK_INGENIC
    help
      Build the clock driver for the Ingenic T40 SoC.

config CLK_T31
    bool "Clock for Ingenic T31 SoC"
    depends on SOC_T31
    select COMMON_CLK_INGENIC
    help
      Build the clock driver for the Ingenic T31 SoC.
```

## drivers/mmc/Kconfig
```kconfig
# SPDX-License-Identifier: GPL-2.0-only
#
# MMC subsystem configuration
#

menuconfig MMC
	tristate "MMC/SD/SDIO card support"
	depends on HAS_IOMEM
	help
	  This selects MultiMediaCard, Secure Digital and Secure
	  Digital I/O support.

	  If you want MMC/SD/SDIO support, you should say Y here and
	  also to your specific host controller driver.

config MMC_DEBUG
	bool "MMC debugging"
	depends on MMC != n
	help
	  This is an option for use by developers; most people should
	  say N here.  This enables MMC core and driver debugging.

config JZMMC_V12
        tristate "Ingenic(XBurst2)  MMC/SD Card Controller(MMC) support"
        select MMC_JZ4740
        help
          This selects the Ingenic XBurst2 SD/MMC Card Controller MMC.
          If you have platform with a SD/Multimedia Card slot and compact
          with this version, say Y or M here.
          If unsure, say N.

if MMC

source "drivers/mmc/core/Kconfig"

source "drivers/mmc/host/Kconfig"

endif # MMC
```

## drivers/power/Kconfig
```kconfig
# SPDX-License-Identifier: GPL-2.0-only
source "drivers/power/avs/Kconfig"

config BATTERY_JZ4740
	tristate "Ingenic JZ4740 battery"
	depends on MACH_JZ4740
	depends on MFD_JZ4740_ADC
	help
	  Say Y to enable support for the battery on Ingenic JZ4740 based
	  boards.

	  This driver can be build as a module. If so, the module will be
	  called jz4740-battery.
source "drivers/power/reset/Kconfig"
source "drivers/power/supply/Kconfig"
```

## drivers/video/ingenic_sensors/Kconfig
```kconfig
menuconfig INGENIC_SENSORS
	tristate "Ingenic Sensor modules for the TX-ISP"
	default m
	help
	  Support for Ingenic Sensors.

config INGENIC_SENSOR_GC2053
	tristate "Ingenic Sensor module for GC2053"
	depends on INGENIC_SENSORS
	default m
	help
	  Module for gc2053.

config INGENIC_SENSOR_SC2336
	tristate "Ingenic Sensor module for SC2336"
	depends on INGENIC_SENSORS
	default m
	help
	  Module for sc2336.
```
